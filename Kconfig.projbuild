## Kconfig.projbuild
```kconfig
menu "Mario AI WiFi Configuration"

    config WIFI_SSID
        string "WiFi SSID"
        default "your_wifi_ssid"
        help
            SSID (network name) for the Mario AI to connect to.

    config WIFI_PASSWORD
        string "WiFi Password"
        default "your_wifi_password"
        help
            WiFi password (WPA or WPA2) for the Mario AI to use.

endmenu
```

## sdkconfig.defaults
```kconfig
# Flash 配置
CONFIG_ESPTOOLPY_FLASHSIZE_16MB=y
CONFIG_ESPTOOLPY_FLASHSIZE="16MB"
CONFIG_ESPTOOLPY_FLASHMODE_QIO=y

# 分区表配置
CONFIG_PARTITION_TABLE_CUSTOM=y
CONFIG_PARTITION_TABLE_CUSTOM_FILENAME="partitions.csv"

# LVGL 字体配置
CONFIG_LV_USE_FONT_COMPRESSED=y
CONFIG_LV_FONT_FMT_TXT_LARGE=y
CONFIG_LV_USE_BINFONT=y
CONFIG_LV_USE_IMGFONT=y

# LVGL 文件系统支持 (用于加载二进制字体)
CONFIG_LV_USE_FS_POSIX=y
CONFIG_LV_FS_POSIX_LETTER=47

# SPIFFS 配置
CONFIG_SPIFFS_MAX_PARTITIONS=3
```
